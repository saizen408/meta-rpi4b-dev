## conf/distro/rpi4b-core-rt.conf
```bitbake
MAINTAINER = "Eric Owusu <owusu.eric@protonmail.com>"

require conf/distro/poky.conf

DISTRO = "rpi4b-core-rt"
DISTRO_NAME = "rpi4b core-rt"
DISTRO_VERSION = "0.0.1"
DISTRO_CODENAME = "rpi4b-core-rt"
SDK_VENDOR = "-rpi4bcorert"
SDK_VERSION := "${@'${DISTRO_VERSION}'.replace('snapshot-${DATE}', 'snapshot')}"

# Configure Package Management Server
# Apt packagemanger shall only be installed
EXTRA_IMAGE_FEATURES += "package-management"
PACKAGE_CLASSES:append = " package_deb"
PRSERV_HOST = "localhost:0"
# Place your own locally hosted server ip here
PACKAGE_FEED_URIS = "http://192.168.99.118:8080"
PACKAGE_FEED_BASE_PATHS = ""
PACKAGE_FEED_ARCHS = "all cortexa72"

# Network Package Configuration
IMAGE_INSTALL:append = " \
						dhcpcd \
						kea \ 
						avahi-daemon \
"

# Set hostname
hostname:pn-base-files = "rpi4-core-rt" 

# Replaces sysv with systemd
DISTRO_FEATURES += "systemd"
VIRTUAL-RUNTIME_init_manager = "systemd"
PREFERRED_PROVIDER_udev = "systemd"
DISTRO_FEATURES:remove = "sysvinit"
VIRTUAL-RUNTIME_initscripts = "systemd-compat-units"
DISTRO_FEATURES_BACKFILL_CONSIDERED += "sysvinit"

PREFERRED_PROVIDER_jpeg = "libjpeg-turbo"
PREFERRED_PROVIDER_jpeg-native = "libjpeg-turbo-native"

# Do not build package features for the folllowing packages.
DISTRO_FEATURES:remove = " wayland"

# Set default timezone (using tzdata package)
DEFAULT_TIMEZONE = "America/Los_Angeles"

# Configure I/O Buses
ENABLE_UART = "1"
ENABLE_DWC2_HOST = "1" 
SERIAL_CONSOLES = "115200;ttyAMA0"
```

## conf/layer.conf
```bitbake
# We have a conf and classes directory, append to BBPATH
BBPATH .= ":${LAYERDIR}"

# We have a recipes directory containing .bb and .bbappend files, add to BBFILES
BBFILES += "${LAYERDIR}/recipes*/*/*.bb \
            ${LAYERDIR}/recipes*/*/*.bbappend"

BBFILE_COLLECTIONS += "rpi4b-dev"
BBFILE_PATTERN_rpi4b-dev := "^${LAYERDIR}/"
BBFILE_PRIORITY_rpi4b-dev = "10"

LAYERDEPENDS_meta-rpi4b-dev += " \
                            core \
                            raspberrypi \
                        "

LAYERSERIES_COMPAT_rpi4b-dev = "kirkstone"


# We have a conf and classes directory, append to BBPATH
BBPATH .= ":${LAYERDIR}"

# Additional license directories.
# Todo add appropriate license 
# LICENSE_PATH += "${LAYERDIR}/files/custom-licenses"
```

## conf/machine/rpi4b-dev.conf
```bitbake
# Custom rpi4b-dev machine that inherits the raspberrypi4-64 machine
# and appends additional overlays and machine depened configs (i.e. mender)

MACHINEOVERRIDES =. "raspberrypi4-64:${MACHINE}"

###################################################
#  BEGIN: Default Raspberrypi4-64.conf file
###################################################
MACHINE_FEATURES += "pci"
MACHINE_EXTRA_RRECOMMENDS += "\
    linux-firmware-rpidistro-bcm43455 \
    bluez-firmware-rpidistro-bcm4345c0-hcd \
    linux-firmware-rpidistro-bcm43456 \
    bluez-firmware-rpidistro-bcm4345c5-hcd \
"
DEFAULTTUNE = "cortexa72"
require conf/machine/include/arm/armv8a/tune-cortexa72.inc
include conf/machine/include/rpi-base.inc
RPI_KERNEL_DEVICETREE = " \
    broadcom/bcm2711-rpi-4-b.dtb \
    broadcom/bcm2711-rpi-400.dtb \
    broadcom/bcm2711-rpi-cm4.dtb \
"
SDIMG_KERNELIMAGE ?= "kernel8.img"
SERIAL_CONSOLES ?= "115200;ttyS0"
UBOOT_MACHINE = "rpi_arm64_config"
VC4DTBO ?= "vc4-kms-v3d"
KERNEL_IMAGETYPE_UBOOT ?= "Image"
KERNEL_IMAGETYPE_DIRECT ?= "Image"
KERNEL_BOOTCMD ?= "booti"
ARMSTUB ?= "armstub8-gic.bin"
###################################################
#  END: Default Raspberrypi4-64.conf file
###################################################


###################################################
#  rpi4b-dev specific Device Tree Configuration
###################################################
RPI_KERNEL_DEVICETREE_OVERLAYS:append = " \
    overlays/pcie-32bit-dma-overlay.dtbo \
    overlays/dwc2.dtbo \
    overlays/vc4-fkms-v3d.dtbo \
    overlays/pwm.dtbo \
"


###################################################+
#  Mender Update Configuration
###################################################
```
